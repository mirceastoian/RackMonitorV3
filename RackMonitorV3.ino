#include <string.h>

#include <SPI.h>
#include <Wire.h>
#include <OneWire.h>
#include <DallasTemperature.h>
#include <Ethernet.h>
#include <Adafruit_GFX.h>
#include <Adafruit_SSD1306.h>
#include <StreamLib.h>
#include <ezButton.h>
#include <Preferences.h>

#define __DEBUG true
#define __TRACE true

#define SCREEN_WIDTH 128
#define SCREEN_HEIGHT 64

#define OLED_RESET -1
#define OLED_ADDRESS 0x3C

#define HTTP_PORT 80

#define ONE_WIRE_BUS 4

#define RELAY1_PIN 16
#define RELAY2_PIN 17
#define BUTTON1_PIN 34
#define BUTTON2_PIN 35
#define BUZZER_PIN 27
#define LED_OK_PIN 32
#define LED_ERROR_PIN 33

#define FIRMWARE_VERSION "1.0.0"

uint8_t deviceEthernetMAC[] = { 0x9E, 0x4E, 0xE9, 0xE1, 0xDC, 0xD5 };

IPAddress ip(192, 168, 55, 155);
IPAddress subnet(255, 255, 255, 0);
IPAddress gateway(192, 168, 55, 1);
IPAddress dns(192, 168, 55, 1);
EthernetServer webServer(HTTP_PORT);
bool ethernetActive = true;

Adafruit_SSD1306 oled(SCREEN_WIDTH, SCREEN_HEIGHT, &Wire, OLED_RESET);
bool alternateFan1 = true;
bool alternateFan2 = true;

ezButton controlButton1(BUTTON1_PIN);
ezButton controlButton2(BUTTON2_PIN);

OneWire oneWire(ONE_WIRE_BUS);

DallasTemperature temperatureSensors(&oneWire);
DeviceAddress tempSensor1 = { 0x28, 0x8E, 0xDA, 0xEF, 0x13, 0x19, 0x01, 0x79 };
DeviceAddress tempSensor2 = { 0x28, 0xA9, 0xB1, 0xE0, 0x13, 0x19, 0x01, 0xB1 };
DeviceAddress tempSensor3 = { 0x28, 0x28, 0x0B, 0x94, 0x97, 0x0E, 0x03, 0xFA };
DeviceAddress tempSensor4 = { 0x28, 0xDB, 0x48, 0x20, 0x14, 0x19, 0x01, 0x51 };

uint8_t sensorsCount = 0;
float temp1, temp2, temp3, temp4;

const uint8_t SAMPLING_INTERVAL_SECONDS = 5;

Preferences preferences;

bool relay1On = false;
bool relay2On = false;

String httpRequest;

const unsigned char ICON_ETHERNET_ON[] PROGMEM = {
  0x3f, 0xfc, 0x40, 0x02, 0x87, 0xe1, 0x84, 0x21, 0xbc, 0x3d, 0xa0, 0x05, 0xa0, 0x05, 0xa0, 0x05, 
  0xa0, 0x05, 0xa0, 0x05, 0xa0, 0x05, 0xaa, 0x55, 0x9f, 0xf9, 0x80, 0x01, 0x40, 0x02, 0x3f, 0xfc
};

const unsigned char ICON_ETHERNET_OFF[] PROGMEM = {
  0x3f, 0xfc, 0x40, 0x02, 0x87, 0xe1, 0x84, 0x21, 0xbc, 0x3d, 0xa0, 0x05, 0xa2, 0x45, 0xa1, 0x85, 
  0xa1, 0x85, 0xa2, 0x45, 0xa0, 0x05, 0xaa, 0x55, 0x9f, 0xf9, 0x80, 0x01, 0x40, 0x02, 0x3f, 0xfc
};

const unsigned char ICON_FAN1[] PROGMEM = {
  0x00, 0x00, 0x0c, 0x00, 0x1c, 0x00, 0x1c, 0x3c, 0x1e, 0x7e, 0x1e, 0x7e, 0x0d, 0xb0, 0x02, 0x40, 
  0x02, 0x40, 0x0d, 0xb0, 0x7e, 0x78, 0x7e, 0x78, 0x3c, 0x38, 0x00, 0x38, 0x00, 0x30, 0x00, 0x00
};

const unsigned char ICON_FAN2[] PROGMEM = {
  0x00, 0x00, 0x00, 0x00, 0x01, 0xe0, 0x03, 0xf0, 0x1b, 0xf0, 0x39, 0x80, 0x39, 0x98, 0x3e, 0x7c, 
  0x3e, 0x7c, 0x19, 0x9c, 0x01, 0x9c, 0x0f, 0xd8, 0x0f, 0xc0, 0x07, 0x80, 0x00, 0x00, 0x00, 0x00
};

// Restart every 24 hours (in milliseconds)
const unsigned long RESTART_TIME = 24 * 60 * 60000UL;
bool restartRequested = false;


void beep()
{
  digitalWrite(BUZZER_PIN, HIGH);
  delay(100);
  digitalWrite(BUZZER_PIN, LOW);
}

void controlLed(uint16_t pin, uint16_t duration)
{
  digitalWrite(pin, HIGH);

  if (duration != 0)
  {
    delay(duration);
    digitalWrite(pin, LOW);
  }
}

void connectToNetwork()
{
  Ethernet.init(5);
  Ethernet.begin(deviceEthernetMAC, ip, dns, gateway, subnet);

  if (Ethernet.hardwareStatus() == EthernetNoHardware)
  {
    ethernetActive = false;
    if (__DEBUG) Serial.println(F("Ethernet device not found."));
    controlLed(LED_ERROR_PIN, 0);
  }

  if (Ethernet.linkStatus() == LinkOFF)
  {
    ethernetActive = false;
    if (__DEBUG) Serial.println(F("Ethernet cable is not plugged in."));
    controlLed(LED_ERROR_PIN, 0);
  }
}

void initializeTemperatureSensors()
{
  temperatureSensors.begin();
  sensorsCount = temperatureSensors.getDeviceCount();
  if (sensorsCount <= 0)
  {
    if (__DEBUG) Serial.println(F("Could not find a valid DS18B20 sensor."));
    controlLed(LED_ERROR_PIN, 0);
  }
  else
  {
    DeviceAddress address;
    if (__DEBUG)
    {  
      Serial.println(F("Found DS18B20 devices:"));

      for (uint8_t i = 0;  i < sensorsCount;  i++)
      {
        Serial.print("Sensor ");
        Serial.print(i+1);
        Serial.print(": ");
        temperatureSensors.getAddress(address, i);
        printSensorAddress(address);
        Serial.println();
      }
    }
  }

  temperatureSensors.setResolution(tempSensor1, 12);
  temperatureSensors.setResolution(tempSensor2, 12);
  temperatureSensors.setResolution(tempSensor3, 12);
  temperatureSensors.setResolution(tempSensor4, 12);
  temperatureSensors.setWaitForConversion(false);
  delay(500);
}

void setup()
{
  Serial.begin(115200);
  delay(1000);

  pinMode(RELAY1_PIN, OUTPUT);
  pinMode(RELAY2_PIN, OUTPUT);
  pinMode(BUTTON1_PIN, INPUT);
  pinMode(BUTTON1_PIN, INPUT);
  pinMode(BUZZER_PIN, OUTPUT);
  pinMode(LED_OK_PIN, OUTPUT);
  pinMode(LED_ERROR_PIN, OUTPUT);

  digitalWrite(RELAY1_PIN, HIGH);
  digitalWrite(RELAY2_PIN, HIGH);

  connectToNetwork();
  initializeTemperatureSensors();

  if(!oled.begin(SSD1306_SWITCHCAPVCC, OLED_ADDRESS))
  {
    Serial.println(F("SSD1306 OLED could not be initialized."));
    controlLed(LED_ERROR_PIN, 0);
  }

  oled.display();
  delay(1000);
  oled.clearDisplay();
  
  webServer.begin();
  if (__DEBUG)
  {
    Serial.println();
    Serial.print(F("Web server started at http://"));
    Serial.print(Ethernet.localIP());
    Serial.println(F("/"));
  }

  preferences.begin("rack-monitor", false);
  relay1On = preferences.getBool("relay1On", false);
  relay2On = preferences.getBool("relay2On", false);
  preferences.end();

  digitalWrite(RELAY1_PIN, relay1On ? LOW : HIGH);
  digitalWrite(RELAY2_PIN, relay2On ? LOW : HIGH);

  controlLed(LED_OK_PIN, 500);
}

void printSensorAddress(DeviceAddress deviceAddress)
{ 
  for (uint8_t i = 0; i < 8; i++)
  {
    Serial.print("0x");
    if (deviceAddress[i] < 0x10) Serial.print("0");
    Serial.print(deviceAddress[i], HEX);
    if (i < 7) Serial.print(", ");
  }
}

float getTemperature(DeviceAddress deviceAddress)
{
  float tempInDegreesCelsius = temperatureSensors.getTempC(deviceAddress);

  if ((tempInDegreesCelsius == DEVICE_DISCONNECTED_C) && __DEBUG)
  {
    Serial.print(F("Error: Could not read temperature data for sensor: "));
    printSensorAddress(deviceAddress);
    Serial.println();
  }

  return tempInDegreesCelsius;
}

void processIncomingServerConnections()
{
  EthernetClient webClient = webServer.available();

  if (webClient)
  {
    if (__DEBUG)
    {
      Serial.println();
      Serial.println(F("New client connected."));
    }
    
    boolean currentLineIsBlank = true;
    
    while (webClient.connected())
    {
      if (webClient.available())
      {
        char c = webClient.read();
        httpRequest += c;

        if (c == '\n' && currentLineIsBlank)
        {
          if (httpRequest.startsWith(F("GET / ")))
            defaultHttpResponse(webClient);
          else if (httpRequest.startsWith(F("GET /favicon.ico")))
            favoriteIconResponse(webClient);
          else if (httpRequest.startsWith(F("GET /status")))
            statusResponse(webClient);
          else if (httpRequest.startsWith(F("GET /metrics")))
            metricsResponse(webClient);
          else if (httpRequest.startsWith(F("GET /relay1-on")))
            relayControlResponse(1, true, webClient);
          else if (httpRequest.startsWith(F("GET /relay1-off")))
            relayControlResponse(1, false, webClient);
          else if (httpRequest.startsWith(F("GET /relay2-on")))
            relayControlResponse(2, true, webClient);
          else if (httpRequest.startsWith(F("GET /relay2-off")))
            relayControlResponse(2, false, webClient);
          else if (httpRequest.startsWith(F("GET /restart")))
            deviceRestartResponse(webClient);
          else if (httpRequest.startsWith(F("GET /relay1-default-on")))
            relayDefaultStateResponse(1, true, webClient);
          else if (httpRequest.startsWith(F("GET /relay1-default-off")))
            relayDefaultStateResponse(1, false, webClient);
          else if (httpRequest.startsWith(F("GET /relay2-default-on")))
            relayDefaultStateResponse(2, true, webClient);
          else if (httpRequest.startsWith(F("GET /relay2-default-off")))
            relayDefaultStateResponse(2, false, webClient);
          else
            notFoundResponse(webClient);
          
          if (__TRACE)
          {
            Serial.println(F("---REQUEST BEGIN---"));
            Serial.println(httpRequest);
            Serial.println(F("---REQUEST END---"));
          }
          break;
        }

        if (c == '\n')
          currentLineIsBlank = true;
        else if (c != '\r')
          currentLineIsBlank = false;
      }
    }

    delay(10);
    httpRequest = "";

    webClient.stop();
    if (__DEBUG) Serial.println(F("Client disconnected."));
  }
}

void notFoundResponse(EthernetClient &webClient)
{
  webClient.println(F("HTTP/1.1 404 Not Found"));
  webClient.println(F("Content-Type: text/plain"));
  webClient.println(F("Connection: close"));
  webClient.println(F("Cache-Control: no-cache"));
  webClient.println(F("X-Content-Type-Options: nosniff"));
  webClient.println();
  webClient.println(F("Not Found"));
}

void favoriteIconResponse(EthernetClient &webClient)
{
  const static uint8_t FAV_ICON_GZIP[] PROGMEM =
  {
    0x1F, 0x8B, 0x08, 0x08, 0x91, 0xA4, 0x3B, 0x65, 0x00, 0x00, 0x66, 0x61, 0x76, 0x69, 0x63, 0x6F, 
    0x6E, 0x2E, 0x69, 0x63, 0x6F, 0x00, 0xEC, 0xDD, 0x7D, 0x4C, 0x13, 0x77, 0x1C, 0xC7, 0xF1, 0xAB, 
    0xF8, 0x80, 0x32, 0x06, 0x3E, 0x44, 0xA7, 0x5B, 0x02, 0x86, 0x29, 0xBA, 0xE9, 0xD4, 0x8C, 0xA0, 
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    0x8E, 0xC5, 0xD6, 0xAF, 0x24, 0xA3, 0xFC, 0x03, 0x4E, 0xE4, 0x06, 0xD7, 0xF9, 0x89, 0x01, 0x00
  };

  char messageBuffer[64];
  BufferedPrint webClientResponse(webClient, messageBuffer, sizeof(messageBuffer));
  
  webClientResponse.print(
    F("HTTP/1.1 200 OK\r\n"
    "Content-Type: image/x-icon\r\n"
    "Content-Encoding: gzip\r\n"
    "\r\n")
  );

  for (uint16_t i = 0; i < sizeof(FAV_ICON_GZIP); i++)
  {
    byte p = pgm_read_byte_near(FAV_ICON_GZIP + i);
    webClientResponse.write(p);
  }
  webClientResponse.flush();
}

void defaultHttpResponse(EthernetClient &webClient)
{
  const static char INDEX_HTML[] PROGMEM = R"rawliteral(
  <!DOCTYPE HTML>
  <html>
  <head>
    <meta name="viewport" content="width=device-width, initial-scale=1">
    <link href="/favicon.ico" rel="icon" type="image/x-icon" />
    <title>Rack Monitor V3</title>
    <style>
      html { font-family: Arial; display: inline-block; text-align: center; }
      p { font-size: 3.0rem; }
      body { max-width: 600px; margin: 0px auto; padding-bottom: 25px; }
      td { padding: 10px; }
      .errormessage { margin: 0px 0px 20px 0px; font-size: 14px; color: #ff0000; font-weight: bold; visibility: hidden; }
      .switch { position: relative; display: inline-block; width: 120px; height: 68px; } 
      .switch input { display: none; }
      .slider { position: absolute; top: 0; left: 0; right: 0; bottom: 0; background-color: #ccc; border-radius: 34px; }
      .slider:before { position: absolute; content: ""; height: 52px; width: 52px; left: 8px; bottom: 8px; background-color: #fff; -webkit-transition: .4s; transition: .4s; border-radius: 68px; }
      input:checked+.slider { background-color: #2196F3; }
      input:checked+.slider:before { -webkit-transform: translateX(52px); -ms-transform: translateX(52px); transform: translateX(52px); }
    </style>
    <script>
      const REFRESH_SECONDS = 30;

      function refreshStates()
      {
        loadStatus();
        setTimeout(refreshStates, REFRESH_SECONDS * 1000);
      }

      function loadStatus()
      {
        callService(document.getElementById("relay1"), "/status");
        callService(document.getElementById("relay2"), "/status");
      }

      function toggleCheckbox(element)
      {
        callService(element, element.checked ? ((element.id == "relay1") ? "/relay1-on" : "relay2-on") : ((element.id == "relay1") ? "/relay1-off" : "relay2-off"));
      }

      function callService(element, url)
      {
        var xhr = new XMLHttpRequest();
        var d = new Date();
       
        xhr.timeout = 10000;
        xhr.onreadystatechange = () => {
          if (xhr.readyState === 4 && xhr.status === 200)
          {
            let data = JSON.parse(xhr.responseText);
            element.checked = (element.id == "relay1") ? (data.relay1 == "on") : (data.relay2 == "on");

            if (element.id == "relay2")
            {
              if (data.temp1 !== undefined) document.getElementById("temp1").innerHTML = "<b>Sensor 1:</b> " + ((data.temp1 != -127) ? data.temp1 + "&deg;C" : "N/A");
              if (data.temp2 !== undefined) document.getElementById("temp2").innerHTML = "<b>Sensor 2:</b> " + ((data.temp2 != -127) ? data.temp2 + "&deg;C" : "N/A");
              if (data.temp3 !== undefined) document.getElementById("temp3").innerHTML = "<b>Sensor 3:</b> " + ((data.temp3 != -127) ? data.temp3 + "&deg;C" : "N/A");
              if (data.temp4 !== undefined) document.getElementById("temp4").innerHTML = "<b>Sensor 4:</b> " + ((data.temp4 != -127) ? data.temp4 + "&deg;C" : "N/A");
            }

            document.getElementById("errormessage").style.visibility = "hidden";
          }
        };
        xhr.onerror = () => {
          document.getElementById("errormessage").textContent = "Error while fetching status. Retrying later.";
          document.getElementById("errormessage").style.visibility = "visible";
        };
        xhr.ontimeout = () => {
          document.getElementById("errormessage").textContent = "Status request timed out. Retrying later.";
          document.getElementById("errormessage").style.visibility = "visible";
        };

        xhr.open("GET", url + "?t=" + d.getTime(), true);
        xhr.send(null);
      }
    </script>
  </head>
  <body onload="refreshStates();">
    <h3>Rack Monitor<br/><p id="errormessage" class="errormessage"></p></h3>
    <table border="0" align="center">
      <tr>
        <td colspan="2" style="text-align: center;">Temperatures</td>
      </tr>
      <tr>
        <td style="text-align: center;" id="temp1"></td>
        <td style="text-align: center;" id="temp2"></td>
      </tr>
      <tr>
        <td style="text-align: center;" id="temp3"></td>
        <td style="text-align: center;" id="temp4"></td>
      </tr>
      <tr>
        <td><h4>Relay 1</h4><label class="switch"><input type="checkbox" onclick="toggleCheckbox(this);" id="relay1" /><span class="slider"></span></label></td>
        <td><h4>Relay 2</h4><label class="switch"><input type="checkbox" onclick="toggleCheckbox(this);" id="relay2" /><span class="slider"></span></label></td>
      </tr>
    </table>
  </body>
  </html>
  )rawliteral";

  char messageBuffer[64];
  BufferedPrint webClientResponse(webClient, messageBuffer, sizeof(messageBuffer));
  
  webClientResponse.print(
    F("HTTP/1.1 200 OK\r\n"
    "Content-Type: text/html\r\n"
    "Connection: close\r\n"
    "Cache-Control: no-cache\r\n"
    "X-Content-Type-Options: nosniff\r\n"
    "\r\n")
  );

  for (uint16_t i = 0; i < sizeof(INDEX_HTML); i++)
  {
    byte p = pgm_read_byte_near(INDEX_HTML + i);
    webClientResponse.write(p);
  }
  webClientResponse.flush();
}

void statusResponse(EthernetClient &webClient)
{
  webClient.print(
    F("HTTP/1.1 200 OK\r\n"
    "Content-Type: application/json; charset=utf-8\r\n"
    "Connection: close\r\n"
    "Cache-Control: no-cache\r\n"
    "X-Content-Type-Options: nosniff\r\n"
    "\r\n")
  );
  
  webClient.println(
    String("{ \"temp1\": ") + String(temp1) +
    String(", \"temp2\": ") + String(temp2) +
    String(", \"temp3\": ") + String(temp3) +
    String(", \"temp4\": ") + String(temp4) +
    String(", \"relay1\": \"") + (relay1On ? "on" : "off") + String("\"") +
    String(", \"relay2\": \"") + (relay2On ? "on" : "off") + String("\"}")
  );
}

void metricsResponse(EthernetClient &webClient)
{
  webClient.println(F("HTTP/1.1 200 OK"));
  webClient.println(F("Content-Type: text/plain; charset=utf-8"));
  webClient.println(F("Connection: close"));
  webClient.println(F("Cache-Control: no-cache"));
  webClient.println(F("X-Content-Type-Options: nosniff"));
  webClient.println();

  webClient.print("# HELP rack_monitor_temp1 Rack monitoring system - temperature of sensor #1 in degrees Celsius.\n");
  webClient.print("# TYPE rack_monitor_temp1 gauge\n");
  webClient.print(String("rack_monitor_temp1 ") + String(temp1) + "\n");

  webClient.print("# HELP rack_monitor_temp2 Rack monitoring system - temperature of sensor #2 in degrees Celsius.\n");
  webClient.print("# TYPE rack_monitor_temp2 gauge\n");
  webClient.print(String("rack_monitor_temp2 ") + String(temp2) + "\n");

  webClient.print("# HELP rack_monitor_temp3 Rack monitoring system - temperature of sensor #3 in degrees Celsius.\n");
  webClient.print("# TYPE rack_monitor_temp3 gauge\n");
  webClient.print(String("rack_monitor_temp3 ") + String(temp3) + "\n");

  webClient.print("# HELP rack_monitor_temp4 Rack monitoring system - temperature of sensor #4 in degrees Celsius.\n");
  webClient.print("# TYPE rack_monitor_temp4 gauge\n");
  webClient.print(String("rack_monitor_temp4 ") + String(temp4) + "\n");

  webClient.print("# HELP rack_monitor_relay1_state Rack monitoring system - Relay #1 state (0 - off, 1 - on).\n");
  webClient.print("# TYPE rack_monitor_relay1_state counter\n");
  webClient.print(String("rack_monitor_relay1_state ") + String(relay1On) + "\n");

  webClient.print("# HELP rack_monitor_relay2_state Rack monitoring system - Relay #2 state (0 - off, 1 - on).\n");
  webClient.print("# TYPE rack_monitor_relay2_state counter\n");
  webClient.print(String("rack_monitor_relay2_state ") + String(relay2On) + "\n");
}

void deviceRestartResponse(EthernetClient &webClient)
{
  restartRequested = true;

  webClient.print(
    F("HTTP/1.1 200 OK\r\n"
    "Content-Type: application/json; charset=utf-8\r\n"
    "Connection: close\r\n"
    "Cache-Control: no-cache\r\n"
    "X-Content-Type-Options: nosniff\r\n"
    "\r\n")
  );

  webClient.println("{ \"status\": \"restarting\" }");
}

void relayDefaultStateResponse(uint8_t relay, bool state, EthernetClient &webClient)
{
  preferences.begin("rack-monitor", false);
  preferences.putBool((relay == 1) ? "relay1On" : "relay2On", state);
  preferences.end();

  webClient.print(
    F("HTTP/1.1 200 OK\r\n"
    "Content-Type: application/json; charset=utf-8\r\n"
    "Connection: close\r\n"
    "Cache-Control: no-cache\r\n"
    "X-Content-Type-Options: nosniff\r\n"
    "\r\n")
  );

  webClient.println("{ \"relay" + String(relay) + "_default_state\": \"" + (state ? "on" : "off") + "\" }");
}

void relayControlResponse(uint8_t relay, bool state, EthernetClient &webClient)
{
  if (relay == 1)
  {
    relay1On = state;
    digitalWrite(RELAY1_PIN, relay1On ? LOW : HIGH);
  }
  else
  {
    relay2On = state;
    digitalWrite(RELAY2_PIN, relay2On ? LOW : HIGH);
  }

  webClient.print(
    F("HTTP/1.1 200 OK\r\n"
    "Content-Type: application/json; charset=utf-8\r\n"
    "Connection: close\r\n"
    "Cache-Control: no-cache\r\n"
    "X-Content-Type-Options: nosniff\r\n"
    "\r\n")
  );

  webClient.println("{ \"relay" + String(relay) + "\": \"" + ((relay == 1) ? (relay1On ? "on" : "off") : (relay2On ? "on" : "off")) + "\" }");
}

void sampleTemperatures()
{
  const unsigned long SAMPLING_TIME = SAMPLING_INTERVAL_SECONDS * 1000UL;
  static unsigned long lastSampleTime = 0 - SAMPLING_TIME;

  if (millis() - lastSampleTime >= SAMPLING_TIME)
  {
    lastSampleTime += SAMPLING_TIME;

    temperatureSensors.requestTemperatures();

    temp1 = getTemperature(tempSensor1);
    temp2 = getTemperature(tempSensor2);
    temp3 = getTemperature(tempSensor3);
    temp4 = getTemperature(tempSensor4);

    if (__TRACE)
    { 
      Serial.println();

      Serial.print(F("Temperatures - sensor #1: "));
      Serial.print(temp1);
      Serial.print(F("*C "));

      Serial.print(F("sensor #2: "));
      Serial.print(temp2);
      Serial.print(F("*C "));
    
      Serial.print(F("sensor #3: "));
      Serial.print(temp3);
      Serial.print(F("*C "));
    
      Serial.print(F("sensor #4: "));
      Serial.print(temp4);
      Serial.println(F("*C"));
    }
  }
}

void renderDisplay()
{
  const unsigned long RENDER_TIME = 500UL;
  static unsigned long lastRenderTime = 0 - RENDER_TIME;

  if (millis() - lastRenderTime >= RENDER_TIME)
  {
    lastRenderTime += RENDER_TIME;

    oled.clearDisplay();
    oled.setTextColor(SSD1306_WHITE);
  
    oled.drawBitmap(0, 0, ethernetActive ? ICON_ETHERNET_ON : ICON_ETHERNET_OFF, 16, 16, 1);
  
    oled.setTextSize(2);
    oled.setCursor(29, 0);
    oled.print("R1");
    oled.setCursor(86, 0);
    oled.print("R2");

    if (relay1On)
    {
      oled.drawBitmap(55, 0, alternateFan1 ? ICON_FAN1 : ICON_FAN2, 16, 16, 1);
      alternateFan1 = !alternateFan1;
    }
    else
    {
      oled.drawBitmap(55, 0, ICON_FAN1, 16, 16, 1);
    }
    
    if (relay2On)
    {
      oled.drawBitmap(112, 0, alternateFan2 ? ICON_FAN1 : ICON_FAN2, 16, 16, 1);
      alternateFan2 = !alternateFan2;
    }
    else
    {
      oled.drawBitmap(112, 0, ICON_FAN1, 16, 16, 1);
    }

    oled.setTextSize(1);
    oled.setCursor(0, 16);
    oled.print("Temp 1 ");
    oled.print((char)247);
    oled.print("C");
    
    oled.setTextSize(2);
    oled.setCursor(0, 24);
    oled.print(temp1, 1);
  
    oled.setTextSize(1);
    oled.setCursor(64, 16);
    oled.print("Temp 2 ");
    oled.print((char)247);
    oled.print("C");
    
    oled.setTextSize(2);
    oled.setCursor(64, 24);
    oled.print(temp2, 1);
  
    oled.setTextSize(1);
    oled.setCursor(0, 39);
    oled.print("Temp 3 ");
    oled.print((char)247);
    oled.print("C");
    
    oled.setTextSize(2);
    oled.setCursor(0, 47);
    oled.print(temp3, 1);
  
    oled.setTextSize(1);
    oled.setCursor(64, 39);
    oled.print("Temp 4 ");
    oled.print((char)247);
    oled.print("C");
  
    oled.setTextSize(2);
    oled.setCursor(64, 47);
    oled.print(temp4, 1);
  
    oled.display();
  }
}

void processButtonStates()
{
  const unsigned long BUTTONS_CHECK_TIME = 200UL;
  static unsigned long lastButtonsCheckTime = 0 - BUTTONS_CHECK_TIME;

  if (millis() - lastButtonsCheckTime >= BUTTONS_CHECK_TIME)
  {
    lastButtonsCheckTime += BUTTONS_CHECK_TIME;

    controlButton1.loop();
    controlButton2.loop();

    if (controlButton1.isReleased())
    {
      if (__DEBUG) Serial.println(F("Button 1 was pressed."));

      relay1On = !relay1On;
      digitalWrite(RELAY1_PIN, relay1On ? LOW : HIGH);
      beep();
      controlLed(LED_OK_PIN, 200);
    }

    if (controlButton2.isReleased())
    {
      if (__DEBUG) Serial.println(F("Button 2 was pressed."));
      
      relay2On = !relay2On;
      digitalWrite(RELAY2_PIN, relay2On ? LOW : HIGH);
      beep();
      controlLed(LED_OK_PIN, 200);
    }
  }
}

void loop()
{
  processButtonStates();
  sampleTemperatures();
  processIncomingServerConnections();
  renderDisplay();

  if (millis() >= RESTART_TIME || restartRequested) ESP.restart();
}

// EOF
